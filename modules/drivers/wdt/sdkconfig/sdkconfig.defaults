## modules/drivers/wdt/sdkconfig/sdkconfig.defaults
```kconfig
#
# Watchdog timer configs
#
CONFIG_ESP_INT_WDT=y
CONFIG_ESP_TASK_WDT_EN=y
CONFIG_ESP_TASK_WDT_INIT=y
CONFIG_ESP_TASK_WDT_PANIC=y
CONFIG_ESP_SYSTEM_PANIC=ESP_SYSTEM_PANIC_PRINT_REBOOT
CONFIG_ESP_SYSTEM_PANIC_REBOOT_DELAY_SECONDS=2
```

## modules/examples/wdt/sdkconfig/sdkconfig.defaults
```kconfig
# Disable core dumps when panicing
CONFIG_ESP_COREDUMP_TO_FLASH_OR_UART=ESP_COREDUMP_ENABLE_TO_NONE
# set individual configs 'cause mc tools don't handle overrides properly
CONFIG_ESP_COREDUMP_ENABLE_TO_UART=n
CONFIG_ESP_COREDUMP_ENABLE_TO_NONE=y
```
